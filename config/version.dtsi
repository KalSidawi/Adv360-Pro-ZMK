#define VERSION_MACRO
macro_ver: macro_ver {
compatible = "zmk,behavior-macro";
#binding-cells = <0>;
wait-ms = <30>;
tap-ms = <40>;
bindings = <&kp N2>, <&kp N0>, <&kp N2>, <&kp N6>, <&kp N0>, <&kp N7>, <&kp N1>, <&kp N4>, <&kp MINUS>, <&kp R>, <&kp E>, <&kp B>, <&kp U>, <&kp MINUS>, <&kp N2>, <&kp N4>, <&kp N3>, <&kp D>, <&kp N1>, <&kp D>, <&kp N5>, <&kp MINUS>, <&kp DOT>, <&kp RET>;
};
